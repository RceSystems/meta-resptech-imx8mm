## conf/layer.conf
```bitbake
# We have a conf and classes directory, add to BBPATH
BBPATH .= ":${LAYERDIR}"

# We have recipes-* directories, add to BBFILES
BBFILES += "${LAYERDIR}/recipes-*/*/*.bb \
            ${LAYERDIR}/recipes-*/*/*.bbappend"

BBFILE_COLLECTIONS += "meta-resptech-imx8mm"
BBFILE_PATTERN_meta-resptech-imx8mm = "^${LAYERDIR}/"
BBFILE_PRIORITY_meta-resptech-imx8mm = "10"

LAYERDEPENDS_meta-resptech-imx8mm = "core"
LAYERSERIES_COMPAT_meta-resptech-imx8mm = "dunfell"
```
